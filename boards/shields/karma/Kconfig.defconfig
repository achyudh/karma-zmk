## boards/shields/karma/Kconfig.defconfig
```kconfig
# Copyright (c) 2023 Achyudh Ram
# SPDX-License-Identifier: MIT

if SHIELD_KARMA_DONGLE

config ZMK_KEYBOARD_NAME
    default "Karma Dongle"

config ZMK_SPLIT_ROLE_CENTRAL
    default y

config ZMK_SPLIT
    default y

config ZMK_SPLIT_BLE_CENTRAL_PERIPHERALS
    default 2

config BT_MAX_CONN
    default 7

config BT_MAX_PAIRED
    default 7

endif

if SHIELD_KARMA_LEFT

config ZMK_KEYBOARD_NAME
    default "Karma"
    
config ZMK_SPLIT_ROLE_CENTRAL
    default y

endif

if SHIELD_KARMA_LEFT || SHIELD_KARMA_RIGHT

config ZMK_SPLIT
    default y

endif
```
