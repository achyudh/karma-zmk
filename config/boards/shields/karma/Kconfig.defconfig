## config/boards/shields/karma/Kconfig.defconfig
```kconfig
# Copyright (c) 2023 Achyudh Ram
# SPDX-License-Identifier: MIT

if SHIELD_KARMA_LEFT

config ZMK_KEYBOARD_NAME
    default "Karma"
    
config ZMK_SPLIT_ROLE_CENTRAL
    default y

endif

if SHIELD_KARMA_LEFT || SHIELD_KARMA_RIGHT

config ZMK_SPLIT
    default y

endif
```

## config/boards/shields/karma/Kconfig.shield
```kconfig
# Copyright (c) 2023 Achyudh Ram
# SPDX-License-Identifier: MIT

config SHIELD_KARMA_LEFT
    def_bool $(shields_list_contains,karma_left)

config SHIELD_KARMA_RIGHT
    def_bool $(shields_list_contains,karma_right)
```
